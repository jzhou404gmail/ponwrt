// SPDX-License-Identifier: (GPL-2.0-only OR BSD-2-Clause)
/dts-v1/;

#include "an7581-fiberhome-hg5585f-common.dtsi"

/*
 * The CU variant maps its four panel ports to internal PHY1 through PHY4.
 *
 * The four panel LAN LEDs are plain active-low GPIOs (GPIO43-46), described as
 * gpio-leds in an7581-fiberhome-hg5585f-common.dtsi and bound to their netdev
 * in board.d/01_leds. Do NOT also mux those pads to phyN_led0 here: a pad
 * drives either the GPIO or the PHY LED output, so selecting the "gbe-led"
 * pinctrl state from gsw_phyN would take all four pads away from the gpio-leds
 * and leave every panel LAN LED dark. An earlier revision of this file did
 * exactly that and was reverted; the pins are not free to be used twice.
 */
&gsw_port1 {
	label = "lan1";
	status = "okay";
};

&gsw_phy1 {
	status = "okay";
};
